## Documentation/devicetree/bindings/iio/adc/ti,ads1120.yaml
```yaml
# SPDX-License-Identifier: (GPL-2.0 OR BSD-2-Clause)
%YAML 1.2
---
$id: http://devicetree.org/schemas/iio/adc/ti,ads1120.yaml#
$schema: http://devicetree.org/meta-schemas/core.yaml#

title: TI ADS1120 4 channel SPI analog to digital converter

maintainers:
  - Jigar Patel <jigar@silmates.com>

description: |
  Datasheet at: https://www.ti.com/lit/gpn/ads1120
  Supports both single ended and differential channels.

properties:
  compatible:
    const: ti,ads1120

  reg:
    maxItems: 1

  "#address-cells":
    const: 1

  "#size-cells":
    const: 0

  "#io-channel-cells":
    const: 1

  ti,vref:
    minimum: 0
    maximum: 5
    description: |
      0 : vref-int : Internal 2.048V .
      1 : refp0,refn0: Reference from REF Channel 0 pins.
      2 : refp1,refn1: Reference from REF Channel 1 pins.
      3 : avdd: Analog supply

required:
  - compatible
  - reg
  - "#address-cells"
  - "#size-cells"
  - ti,vref

additionalProperties: false

patternProperties:
  "^channel@[0-4]+$":
    type: object
    description:
      Child nodes needed for each channel that the platform uses.

    properties:
      reg:
        description: |
          0: Channel 1.
          1: Channel 2.
          2: Channel 3.
          3: Channel 4.
        items:
          - minimum: 0
            maximum: 3

      ti,mux:
        $ref: /schemas/types.yaml#/definitions/uint32
        minimum: 0
        maximum: 11
        description: |
          0: Voltage over AIN0 and AIN1.
          1: Voltage over AIN0 and AIN2.
          2: Voltage over AIN0 and AIN3.
          3: Voltage over AIN1 and AIN2.
          4: Voltage over AIN1 and AIN3.
          5: Voltage over AIN2 and AIN3.
          6: Voltage over AIN1 and AIN0.
          7: Voltage over AIN3 and AIN2.
          8: Voltage over AIN0 and GND.
          9: Voltage over AIN1 and GND.
          10: Voltage over AIN2 and GND.
          11: Voltage over AIN3 and GND.

      ti,gain:
        $ref: /schemas/types.yaml#/definitions/uint32
        minimum: 0
        maximum: 5
        description: |
          pga is the programmable gain amplifier (values are full scale)
          0: 1 (default)
          1: 2
          2: 4 
          3: 8
          4: 16
          5: 32
          6: 64
          7: 128

      ti,gain-bypass:
        description:
          Boolean property which set's the gain to be bypassed for this channel.
        type: boolean

      ti,datarate:
        $ref: /schemas/types.yaml#/definitions/uint32
        minimum: 0
        maximum: 6
        description: |
          Data acquisition rate in samples per second
          0: 128
          1: 250
          2: 490
          3: 920
          4: 1600 (default)
          5: 2400
          6: 3300

      ti,idac:
        $ref: /schemas/types.yaml#/definitions/uint32
        minimum: 0
        maximum: 1
        description: |
          IDAC channel selection
          0 : IDAC channel 1
          1 : IDAC channel 2

      ti,idac-ua:
        $ref: /schemas/types.yaml#/definitions/uint32
        minimum: 0
        maximum: 5
        description: |
          Data acquisition rate in samples per second
          50
          100
          250
          500
          1000
          2000

      ti,idac-mux:
        $ref: /schemas/types.yaml#/definitions/uint32
        minimum: 0
        maximum: 5
        description: |
          IDAC output channel
          0: Disabled (default)
          1: IDAC connected to AIN0
          2: IDAC connected to AIN1
          3: IDAC connected to AIN2
          4: IDAC connected to AIN3
          5: IDAC connected to REFP0
          6: IDAC connected to REFN0

      ti,rsense-val-milli-ohms:
        description:
          Sets the value of the sense resistor.

    required:
      - reg

examples:
  - |
    spi {
        #address-cells = <1>;
        #size-cells = <0>;

        adc {
            compatible = "ti,ads1120";
            #address-cells = <1>;
            #size-cells = <0>;
            ti,vref = <0>;

            channel@0 {
              reg = <0>;
              ti,gain = <1>;
              ti,datarate = <20>;
              ti,idac = <0>;
              ti,idac-ua = <250>;
              ti,idac-mux = <0>;
              ti,mux = <11>;
              ti,gain-bypass;
            };
            channel@1 {
              reg = <1>;
              ti,gain = <1>;
              ti,datarate = <20>;
              ti,idac = <0>;
              ti,idac-ua = <250>;
              ti,idac-mux = <1>;
              ti,mux = <11>;
              ti,rsense-val-milli-ohms = <1650000>; //1.65Kohms
            };
            channel@2 {
              reg = <2>;
              ti,gain = <1>;
              ti,datarate = <20>;
              ti,idac = <0>;
              ti,idac-ua = <250>;
              ti,idac-mux = <2>;
              ti,mux = <11>;
              ti,rsense-val-milli-ohms = <1650000>; //1.65Kohms
            };
        };
    };
...
```

## drivers/gpu/drm/bridge/sn65dsi83/Kconfig
```kconfig
# SPDX-License-Identifier: GPL-2.0-only
config DRM_I2C_SN65DSI83
	bool "TI SN65DSI83 MIPI DSI to LVDS bridge"
	depends on OF
	select DRM_MIPI_DSI
	select VIDEOMODE_HELPERS
	help
	  TI SN65DSI83 MIPI DSI to LVDS bridge driver
```
